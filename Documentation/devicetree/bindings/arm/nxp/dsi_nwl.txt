## Documentation/devicetree/bindings/arm/nxp/dsi_nwl.txt
```
Northwest Logic MIPI-DSI controller for MX8

The MIPI-DSI IP found on MX8 platforms drives the video signal from
Display Controller to video peripherals using DSI protocol.

Required properties:
- compatible: 		"nxp,imx8qm-mipi-dsi"
			"nxp,imx8qxp-mipi-dsi"
			"nxp,imx8mq-mipi-dsi"
- reg: 			The register range of the MIPI-DSI controller
- interrupts: 		The interrupt number for this module
- clocks: 		Array of clocks needed by this module
- phys: 		The phy module representing the DPHY inside
			MIPI-DSI IP block
- instance: 		If there are multiple MIPI-DSI IP blocks,
			define the instance number
- port: 		The remote-enpoint to which this module is connected
			Usually, this is the Display Interface of the Display
			Controller

Example:
	mipi0_dsi: mipi0_dsi@56228000 {
                compatible = "nxp,imx8qm-mipi-dsi";
                reg = <0x0 0x56228000 0x0 0x1000>;
                interrupts = <16 IRQ_TYPE_LEVEL_HIGH>;
                interrupt-parent = <&irqsteer_dsi0>;
                clocks =
                        <&clk IMX8QM_MIPI0_PXL_CLK>,
                        <&clk IMX8QM_MIPI0_BYPASS_CLK>,
                        <&clk IMX8QM_MIPI0_DSI_TX_ESC_CLK>,
                        <&clk IMX8QM_MIPI0_DSI_RX_ESC_CLK>;
                clock-names = "pixel", "bypass", "tx_esc", "rx_esc";
                power-domains = <&pd_mipi0>;
                csr = <&mipi0_csr>;
                phys = <&mipi0_phy>;
                phy-names = "dphy";
                instance = <0>;
                data_lanes = <4>;
                status = "disabled";

                port@0 {
                        mipi0_in: endpoint {
                                remote-endpoint = <&dpu1_disp0_mipi_dsi>;
                        };
                };

        };
```

## Documentation/devicetree/bindings/arm/nxp/phy_mixel.txt
```
Mixel DSI DPHY for MX8

The MIPI-DSI DPHY IP block found on MX8 platforms comes along the MIPI-DSI
IP from Northwest Logic and represents the physical layer for the electrical
signals for DSI.

Required properties:
- compatible: 		"mixel,mipi-phy"
- reg:			The register range of the PHY controller
- id:			If there are multiple PHY blocks,
			define the instance number

Example:
	mipi0_phy: mipi0_phy@56228300 {
                #address-cells = <1>;
                #size-cells = <0>;
                compatible = "mixel,mipi-phy";
                reg = <0x0 0x56228300 0x0 0x100>;
                power-domains = <&pd_mipi0>;
                use_sc;
                id = <0>;
                status = "disabled";
                #phy-cells = <0>;
        };
```

## Documentation/devicetree/bindings/pinctrl/fsl,imx8dv-pinctrl.txt
```
* Freescale i.MX8 DV IOMUX Controller

Required properties:
- compatible: "fsl,imx8dv-iomuxc"
- fsl,pins: each entry consists of 7 integers. Its' format is
  <pin_id pin_flags mux config iso wakeup gp>.

pin_flags definition:
#define IMX_SCU_PIN_MUX_SET_MASK        (1 << 0)
#define IMX_SCU_PIN_WAKEUP_SET_MASK     (1 << 1)
#define IMX_SCU_PIN_GP_SET_MASK         (1 << 2)
If IMX_SCU_PIN_MUX_SET_MASK is set, mux config iso will be set, since
we only have one scu api to set mux/config/iso.
```

## arch/arm64/configs/imx8dv_defconfig
```kconfig
# CONFIG_LOCALVERSION_AUTO is not set
CONFIG_NET=y
CONFIG_PACKET=y
CONFIG_UNIX=y
CONFIG_INET=y
CONFIG_IP_PNP=y
CONFIG_IP_PNP_DHCP=y
# CONFIG_IPV6 is not set
CONFIG_NETDEVICES=y
CONFIG_FIXED_PHY=y
CONFIG_SYSVIPC=y
CONFIG_FHANDLE=y
CONFIG_IRQ_DOMAIN_DEBUG=y
CONFIG_NO_HZ_IDLE=y
CONFIG_HIGH_RES_TIMERS=y
CONFIG_BSD_PROCESS_ACCT=y
CONFIG_BSD_PROCESS_ACCT_V3=y
CONFIG_IKCONFIG=y
CONFIG_IKCONFIG_PROC=y
CONFIG_LOG_BUF_SHIFT=14
# CONFIG_UTS_NS is not set
# CONFIG_IPC_NS is not set
CONFIG_KALLSYMS_ALL=y
CONFIG_PERF_EVENTS=y
# CONFIG_COMPAT_BRK is not set
CONFIG_JUMP_LABEL=y
CONFIG_MODULES=y
CONFIG_MODULE_UNLOAD=y
# CONFIG_BLK_DEV_BSG is not set
# CONFIG_IOSCHED_DEADLINE is not set
CONFIG_ARCH_FSL_IMX8DV=y
CONFIG_ARCH_VEXPRESS=y
# CONFIG_ARM64_ERRATUM_832075 is not set
CONFIG_SMP=y
CONFIG_HOTPLUG_CPU=y
CONFIG_PREEMPT=y
CONFIG_KSM=y
CONFIG_TRANSPARENT_HUGEPAGE=y
CONFIG_CMA=y
CONFIG_CMDLINE="console=ttyAMA0"
# CONFIG_EFI is not set
# CONFIG_CORE_DUMP_DEFAULT_ELF_HEADERS is not set
CONFIG_COMPAT=y
# CONFIG_SUSPEND is not set
CONFIG_UEVENT_HELPER_PATH="/sbin/hotplug"
CONFIG_DEVTMPFS=y
CONFIG_DEVTMPFS_MOUNT=y
CONFIG_DMA_CMA=y
CONFIG_CMA_SIZE_MBYTES=320
CONFIG_MTD=y
CONFIG_MTD_CMDLINE_PARTS=y
CONFIG_MTD_BLOCK=y
CONFIG_MTD_RAM=y
CONFIG_MTD_SLRAM=y
CONFIG_BLK_DEV_LOOP=y
# CONFIG_VEXPRESS_SYSCFG is not set
# CONFIG_INPUT_MOUSEDEV is not set
CONFIG_INPUT_EVDEV=y
# CONFIG_INPUT_MOUSE is not set
# CONFIG_SERIO_SERPORT is not set
CONFIG_SERIO_AMBAKMI=y
CONFIG_VT_HW_CONSOLE_BINDING=y
CONFIG_LEGACY_PTY_COUNT=16
CONFIG_SERIAL_IMX_CONSOLE=y
# CONFIG_HW_RANDOM is not set
CONFIG_POWER_RESET_SYSCON=y
# CONFIG_HWMON is not set
# CONFIG_MFD_VEXPRESS_SYSREG is not set
CONFIG_FB=y
CONFIG_FB_IMXDPU=y
# CONFIG_HID is not set
# CONFIG_USB_SUPPORT is not set
CONFIG_MMC=y
CONFIG_MMC_SDHCI=y
CONFIG_MMC_SDHCI_PLTFM=y
CONFIG_MMC_SDHCI_ESDHC_IMX=y

CONFIG_MXC_GPU_VIV=y
CONFIG_MXC_IMXDPU=y
# CONFIG_CLK_SP810 is not set
# CONFIG_CLK_VEXPRESS_OSC is not set
# CONFIG_COMMON_CLK_XGENE is not set
# CONFIG_IOMMU_SUPPORT is not set
CONFIG_EXT2_FS=y
CONFIG_EXT3_FS=y
# CONFIG_EXT3_DEFAULTS_TO_ORDERED is not set
# CONFIG_EXT3_FS_XATTR is not set
CONFIG_EXT4_FS=y
CONFIG_FANOTIFY=y
CONFIG_AUTOFS4_FS=y
CONFIG_TMPFS=y
CONFIG_HUGETLBFS=y
# CONFIG_MISC_FILESYSTEMS is not set
CONFIG_NLS=y
CONFIG_NLS_CODEPAGE_437=y
CONFIG_NLS_ISO8859_1=y
CONFIG_DEBUG_INFO=y
CONFIG_DEBUG_FS=y
CONFIG_MAGIC_SYSRQ=y
CONFIG_DEBUG_KERNEL=y
CONFIG_LOCKUP_DETECTOR=y
# CONFIG_SCHED_DEBUG is not set
# CONFIG_DEBUG_PREEMPT is not set
# CONFIG_FTRACE is not set
CONFIG_CRYPTO_ANSI_CPRNG=y
CONFIG_ARM64_CRYPTO=y
CONFIG_CRYPTO_SHA1_ARM64_CE=y
CONFIG_CRYPTO_SHA2_ARM64_CE=y
CONFIG_CRYPTO_GHASH_ARM64_CE=y
CONFIG_CRYPTO_AES_ARM64_CE_CCM=y
CONFIG_CRYPTO_AES_ARM64_CE_BLK=y
CONFIG_CRYPTO_AES_ARM64_NEON_BLK=y
CONFIG_CRC_ITU_T=y
CONFIG_CRC7=y
CONFIG_XZ_DEC=y
CONFIG_AVERAGE=y
CONFIG_NEW_LEDS=y
CONFIG_LEDS_CLASS=y
CONFIG_LEDS_GPIO=y
```

## drivers/gpu/drm/imx/dpu-blit/Kconfig
```kconfig
config DRM_IMX_DPU_BLIT
	tristate "DRM DPU BLIT"
	depends on IMX_DPU_BLIT
	default y
	help
		i.MX8QXP and i.MX8QM BLIT ENGINE
```

## drivers/gpu/imx/dpu-blit/Kconfig
```kconfig
config IMX_DPU_BLIT
	tristate
	depends on IMX_DPU_CORE
	depends on DRM_IMX
	default y if DRM_IMX=y
	default m if DRM_IMX=m
```

## drivers/mxc/Kconfig
```kconfig
# drivers/mxc/Kconfig

if ARCH_FSL_IMX8DV

menu "MXC support drivers"

source "drivers/mxc/gpu-viv/Kconfig"
source "drivers/mxc/vpu/Kconfig"
config MXC_IMXDPU
	bool "Display Processing Unit Driver"
	select MXC_IMXDPU_DRV 
	help
	  If you plan to use the Display Processing unit, say
	  Y here. IMXDPU is needed by Framebuffer and V4L2 drivers.

endmenu

endif
```

## drivers/mxc/gpu-viv/Kconfig
```kconfig
menu "MXC Vivante GPU support"
	depends on ARCH_FSL_IMX8DV

config MXC_GPU_VIV
	tristate "MXC Vivante GPU support"
	---help---
         Say Y to get the GPU driver support.

endmenu
```

## drivers/mxc/vpu/Kconfig
```kconfig
#
# Codec configuration
#

menu "MXC VPU(Video Processing Unit) support"
	depends on ARCH_FSL_IMX8DV

config MXC_VPU
	tristate "Support for MXC VPU(Video Processing Unit)"
	default n
	select MEDIA_SUPPORT
	select MEDIA_CAMERA_SUPPORT
	select MEDIA_RC_SUPPORT
	select MEDIA_CONTROLLER
	select VIDEO_DEV
	select VIDEO_V4L2
	select VIDEO_V4L2_SUBDEV_API
	select VIDEOBUF_GEN
	select VIDEOBUF2_CORE
	select V4L2_MEM2MEM_DEV
	select VIDEOBUF2_VMALLOC
	select VIDEOBUF2_MEMOPS
	select VIDEOBUF2_DMA_CONTIG
	---help---
         VPU codec device.

config MXC_VPU_DEBUG
	bool "MXC VPU debugging"
	depends on MXC_VPU != n
	help
	  This is an option for the developers; most people should
	  say N here.  This enables MXC VPU driver debugging.

endmenu
```

## drivers/soc/imx8/Kconfig
```kconfig
# drivers/soc/imx8/Kconfig
#
# Copyright (c) 2010-2011 Samsung Electronics Co., Ltd.
#               http://www.samsung.com/
#
# Licensed under GPLv2

# Configuration options for NXP IMX8

config ARCH_NXP_IMX8
	select PM_GENERIC_DOMAINS if PM
```

## drivers/usb/otg/Kconfig
```kconfig
config TRANSCEIVER_MXC_OTG
	tristate "USB OTG pin detect support"
	depends on (MC13783_MXC || ISP1504_MXC) && USB_GADGET && USB_EHCI_HCD && USB_OTG
	help
	  Support for USB OTG PIN detect on MXC platforms.

config UTMI_MXC_OTG
	tristate "USB OTG pin detect support for UTMI PHY"
	depends on  USB_EHCI_FSL_UTMI && USB_GADGET && USB_EHCI_HCD && USB_OTG
	help
	  Support for USB OTG PIN detect for UTMI PHY on MXC platforms.
 
comment "OTG and related infrastructure"
 
if USB || USB_GADGET
 
config USB_OTG_UTILS
 	bool
 	help
 	  Select this to make sure the build includes objects from
 	  the OTG infrastructure directory.
 
#
# USB Transceiver Drivers
#
config USB_GPIO_VBUS
 	tristate "GPIO based peripheral-only VBUS sensing 'transceiver'"
 	depends on GENERIC_GPIO
 	select USB_OTG_UTILS
 	help
 	  Provides simple GPIO VBUS sensing for controllers with an
 	  internal transceiver via the otg_transceiver interface, and
 	  optionally control of a D+ pullup GPIO as well as a VBUS
 	  current limit regulator.

endif
```
